## config/west.yml
```yaml
# manifest:
#   remotes:
#     - name: zmkfirmware
#       url-base: https://github.com/zmkfirmware
#   projects:
#     - name: zmk
#       remote: zmkfirmware
#       revision: main
#       import: app/west.yml
#   self:
#     path: config

manifest:
  remotes:
    - name: TinySilverfish
      url-base: https://github.com/TinySilverfish
  projects:
    - name: zmk
      remote: caksoylar
      revision: caksoylar/zen-v1+v2  # custom branch name
      import: app/west.yml
  self:
    path: config
```
